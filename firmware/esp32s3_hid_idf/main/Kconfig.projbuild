## firmware/esp32s3_hid_idf/main/Kconfig.projbuild
```kconfig
menu "hidbridge"

    config HIDBRIDGE_BLE_NAME
        string "BLE device name"
        default "hidbridge"
        help
            Advertised BLE name; the daemon scans for this with -ble.

    config HIDBRIDGE_WIFI_SSID
        string "WiFi SSID"
        default "changeme"
        help
            Wi-Fi network to join. Left at "changeme" (or empty) => Wi-Fi is not
            started (cable + BLE only). Set it to enable the Wi-Fi/TCP transport.

    config HIDBRIDGE_WIFI_PASSWORD
        string "WiFi password"
        default "changeme"

    config HIDBRIDGE_TCP_PORT
        int "Wi-Fi TCP port"
        default 3232

    config HIDBRIDGE_MDNS_HOSTNAME
        string "Wi-Fi mDNS hostname (without .local)"
        default "hidbridge"

    config HIDBRIDGE_OTA_TOKEN
        string "OTA update token"
        default "changeme"
        help
            Shared secret the daemon must send (in the OTA_BEGIN frame) before the
            board accepts a firmware update. Set it (here or in .env) and put the
            same value in the daemon's config.json "otaToken".

endmenu
```

## firmware/esp32s3_hid_idf/sdkconfig.defaults
```kconfig
# Target
CONFIG_IDF_TARGET="esp32s3"

# One HID interface (TinyUSB). Native USB-OTG drives HID toward the target.
CONFIG_TINYUSB_HID_COUNT=1

# UART0 carries binary data, so keep the console off it.
CONFIG_ESP_CONSOLE_UART_NONE=y

# 1 kHz tick: the default 100 Hz makes pdMS_TO_TICKS(1) round to 0, so the USB
# "wait until ready" in send_report doesn't actually wait (reports get dropped
# under bursts) and UART reads batch at 10-20 ms. 1 kHz gives real 1 ms timing,
# which keeps the mouse stream smooth instead of jerky.
CONFIG_FREERTOS_HZ=1000

# BLE transport via NimBLE.
CONFIG_BT_ENABLED=y
CONFIG_BT_NIMBLE_ENABLED=y

# NimBLE + TinyUSB don't fit the default 1 MB app partition — use a custom table.
CONFIG_PARTITION_TABLE_CUSTOM=y
CONFIG_PARTITION_TABLE_CUSTOM_FILENAME="partitions.csv"

# 16 MB flash (matches the board) so the dual 1.5 MB OTA slots fit.
CONFIG_ESPTOOLPY_FLASHSIZE_16MB=y
CONFIG_ESPTOOLPY_FLASHSIZE="16MB"

# OTA with rollback: a freshly flashed image boots as "pending verify"; if it
# fails to reach app_main's esp_ota_mark_app_valid_cancel_rollback() the
# bootloader reverts to the previous slot on the next reset.
CONFIG_BOOTLOADER_APP_ROLLBACK_ENABLE=y
```
